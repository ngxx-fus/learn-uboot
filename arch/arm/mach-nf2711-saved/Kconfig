## arch/arm/mach-nf2711-saved/Kconfig
```kconfig
config NF2711
	bool "NgxxFus NF2711 SoC support"
	depends on ARCH_NF271X
	depends on ARCH_NF2711

####################################NGXXFUS-MODIFY################################

config NF2711_32B
	bool "NGXXFUS NF2711 SoC 32-bit support"
	depends on ARCH_NF2711
	depends on ARCH_NF271X
	select NF711
	select ARMV7_LPAE
	select CPU_V7A
	select PHYS_64BIT


config NF2711_64B
	bool "NGXXFUS NF2711 SoC 64-bit support"
	depends on ARCH_NF2711
	select NF2711
	select ARM64

####################################NGXXFUS-MODIFY################################

menu "NGXXFUS NF2711s family"
	depends on ARCH_NF2711
choice
	prompt "Ngxxfus NF2711s board select"
	optional

####################################NGXXFUS-MODIFY################################
config TARGET_MYRPI4CP_32
	bool "MYRPI4CP_32 build (32-bit)"
	help
        NEW BOARD 32BIT WITH NF2711!

    select NF2711_32B
	imply OF_HAS_PRIOR_STAGE

config TARGET_MYRPI4CP
	bool "MYRPI4CP build (64-bit)"
	help
        NEW BOARD 64BIT WITH NF2711!
    select NF2711_64B
    select MMC
    select MMC_SDHCI
    select MMC_SDHCI_NF2711
    select DM_SERIAL
	imply OF_HAS_PRIOR_STAGE

####################################NGXXFUS-MODIFY################################

endchoice

config SYS_BOARD
    string
    default "myrpi4cp"

config SYS_VENDOR
    string
    default "ngxxfus"

config SYS_CONFIG_NAME
    string
    default "myrpi4cp"

# source "board/raspberrypi/rpi/Kconfig"

####################################NGXXFUS-MODIFY################################
source "board/ngxxfus/myrpi4cp/Kconfig"
####################################NGXXFUS-MODIFY################################


endmenu
```

## arch/arm/mach-nf271x/Kconfig
```kconfig
source "board/ngxxfus/myrpi4cp/Kconfig"

config NF2711
	bool "NgxxFus NF2711 SoC support (32/64-bit)"
	depends on ARCH_NF271X

config NF2711_32B
	bool "NGXXFUS NF2711 SoC 32-bit support"
	depends on ARCH_NF271X
	select NF2711
	select ARMV7_LPAE
	select CPU_V7A
	select PHYS_64BIT


config NF2711_64B
	bool "NGXXFUS NF2711 SoC 64-bit support"
	depends on ARCH_NF271X
	select NF2711
	select ARM64

menu "NGXXFUS NF271X family"
	depends on ARCH_NF271X
choice
	prompt "Ngxxfus NF271X board select"
	optional

config TARGET_MYRPI4CP_32
	bool "MYRPI4CP_32 build (32-bit)"
	help
        NEW BOARD 32BIT WITH NF2711!

    select NF2711_32B
	imply OF_HAS_PRIOR_STAGE

config TARGET_MYRPI4CP
	bool "MYRPI4CP build (64-bit)"
	help
        NEW BOARD 64BIT WITH NF2711!
    select NF2711_64B
    select MMC
    select MMC_SDHCI
    select MMC_SDHCI_NF2711
    select DM_SERIAL
	imply OF_HAS_PRIOR_STAGE

endchoice

endmenu


config SYS_BOARD
    string
    default "myrpi4cp"

config SYS_VENDOR
    string
    default "ngxxfus"

config SYS_CONFIG_NAME
    string
    default "myrpi4cp"

config SYS_SOC
	default "nf271x"
```

## arch/arm/mach-nf283x/Kconfig
```kconfig
config NF2835
	bool "FakeBroadcom NF2835 SoC support"
	depends on ARCH_NF283X
	select CPU_ARM1176

config NF2836
	bool "FakeBroadcom NF2836 SoC support"
	depends on ARCH_NF283X
	select ARMV7_LPAE
	select CPU_V7A

config NF2837
	bool "FakeBroadcom NF2837 SoC support"
	depends on ARCH_NF283X

config NF2837_32B
	bool "FakeBroadcom NF2837 SoC 32-bit support"
	depends on ARCH_NF283X
	select NF2837
	select ARMV7_LPAE
	select CPU_V7A

config NF2837_64B
	bool "FakeBroadcom NF2837 SoC 64-bit support"
	depends on ARCH_NF283X
	select NF2837
	select ARM64

config NF2711
	bool "FakeBroadcom NF2711 SoC support"
	depends on ARCH_NF283X

config NF2711_32B
	bool "FakeBroadcom NF2711 SoC 32-bit support"
	depends on ARCH_NF283X
	select NF2711
	select ARMV7_LPAE
	select CPU_V7A
	select PHYS_64BIT

config NF2711_64B
	bool "FakeBroadcom NF2711 SoC 64-bit support"
	depends on ARCH_NF283X
	select NF2711
	select ARM64

menu "FakeBroadcom NF283X family"
	depends on ARCH_NF283X

choice
	prompt "FakeBroadcom NF283X board select"
	optional

config TARGET_NFUS
	bool "Ngxxfus Fus (all NF2835 variants)"
	help
	  Support for all ARM1176-/NF2835-based Ngxxfus Fus variants, such as
	  the A, A+, B, B+, Compute Module, and Zero. This option cannot
	  support NF2836/NF2837-based Ngxxfus Fuss such as the NFUS 2 and
	  Nfus 3 due to different peripheral address maps.

	  This option creates a build targeting the ARM1176 ISA.
	select NF2835

config TARGET_NFUS_0_W
	bool "Ngxxfus Fus Zero W"
	help
	  Support for all ARM1176-/NF2835-based Ngxxfus Fus variants, such as
	  the NFus Zero model W.

	  This option assumes the VideoCore firmware is configured to use the
	  mini UART (rather than PL011) for the serial console. This is the
	  default on the NFus Zero W. To enable the UART console, the following
	  non-default option must be present in config.txt: enable_uart=1.
	  This is required for U-Boot to operate correctly, even if you only
	  care about the HDMI/usbkbd console.

	  This option creates a build targeting the ARMv7/AArch32 ISA.
	select NF2835

config TARGET_NFUS_2
	bool "Ngxxfus Fus 2"
	help
	  Support for all NF2836-based Ngxxfus Fus variants, such as
	  the NFus 2 model B.

	  This option also supports NF2837-based variants such as the NFus 3
	  Model B, when run in 32-bit mode, provided you have configured the
	  VideoCore firmware to select the PL011 UART for the console by:
	  a) config.txt should contain dtoverlay=pi3-miniuart-bt.
	  b) You should run the following to tell the VC FW to process DT when
	  booting, and copy u-boot.bin.img (rather than u-boot.bin) to the SD
	  card as the kernel image:

	       path/to/kernel/scripts/mkknlimg --dtok u-boot.bin u-boot.bin.img

	  This works as of firmware.git commit 046effa13ebc "firmware:
	  arm_loader: emmc clock depends on core clock See:
	  https://github.com/raspberrypi/firmware/issues/572".

	  This option creates a build targeting the ARMv7/AArch32 ISA.
	select NF2836

config TARGET_NFUS_3_32B
	bool "Ngxxfus Fus 3 32-bit build"
	help
	  Support for all NF2837-based Ngxxfus Fus variants, such as
	  the NFus 3 model B, in AArch32 (32-bit) mode.

	  This option assumes the VideoCore firmware is configured to use the
	  mini UART (rather than PL011) for the serial console. This is the
	  default on the NFus 3. To enable the UART console, the following non-
	  default option must be present in config.txt: enable_uart=1. This is
	  required for U-Boot to operate correctly, even if you only care
	  about the HDMI/usbkbd console.

	  This option creates a build targeting the ARMv7/AArch32 ISA.
	select NF2837_32B

config TARGET_NFUS_3
	bool "Ngxxfus Fus 3 64-bit build"
	help
	  Support for all NF2837-based Ngxxfus Fus variants, such as
	  the NFus 3 model B, in AArch64 (64-bit) mode.

	  This option assumes the VideoCore firmware is configured to use the
	  mini UART (rather than PL011) for the serial console. This is the
	  default on the NFus 3. To enable the UART console, the following non-
	  default option must be present in config.txt: enable_uart=1. This is
	  required for U-Boot to operate correctly, even if you only care
	  about the HDMI/usbkbd console.

	  At the time of writing, the VC FW requires a non-default option in
	  config.txt to request the ARM CPU boot in 64-bit mode:
	  arm_control=0x200

	  The VC FW typically provides ARM "stub" code to set up the CPU and
	  quiesce secondary SMP CPUs. This is not currently true in 64-bit
	  mode. In order to boot U-Boot before the VC FW is enhanced, please
	  see the commit description for the commit which added NFus3 support
	  for a workaround. Since the instructions are temporary, they are not
	  duplicated here. The VC FW enhancement is tracked in
	  https://github.com/raspberrypi/firmware/issues/579.

	  This option creates a build targeting the ARMv8/AArch64 ISA.
	select NF2837_64B

config TARGET_NFUS_4_32B
	bool "Ngxxfus Fus 4 32-bit build"
	help
	  Support for all NF2711-based Ngxxfus Fus variants, such as
	  the NFus 4 model B, in AArch32 (32-bit) mode.

	  This option assumes the VideoCore firmware is configured to use the
	  mini UART (rather than PL011) for the serial console. This is the
	  default on the NFus 4. To enable the UART console, the following non-
	  default option must be present in config.txt: enable_uart=1. This is
	  required for U-Boot to operate correctly, even if you only care
	  about the HDMI/usbkbd console.

	  Due to hardware incompatibilities, this can't be used with
	  NF283/5/6/7.

	  This option creates a build targeting the ARMv7/AArch32 ISA.
	select NF2711_32B
	imply OF_HAS_PRIOR_STAGE

config TARGET_NFUS_4
	bool "Ngxxfus Fus 4 64-bit build"
	help
	  Support for all NF2711-based Ngxxfus Fus variants, such as
	  the NFus 4 model B, in AArch64 (64-bit) mode.

	  This option assumes the VideoCore firmware is configured to use the
	  mini UART (rather than PL011) for the serial console. This is the
	  default on the NFus 4. To enable the UART console, the following non-
	  default option must be present in config.txt: enable_uart=1. This is
	  required for U-Boot to operate correctly, even if you only care
	  about the HDMI/usbkbd console.

	  Due to hardware incompatibilities, this can't be used with
	  NF283/5/6/7.

	  Also, due to a bug in firmware, switching to 64bit mode doesn't
	  happen automatically based on the kernel's image filename. See
	  https://github.com/raspberrypi/firmware/issues/1193 for more details.
	  Until that is resolved, the configuration (config.txt) needs to
	  explicitly set: arm_64bit=1.

	  This option creates a build targeting the ARMv8/AArch64 ISA.
	select NF2711_64B
	imply OF_HAS_PRIOR_STAGE

config TARGET_NFUS_ARM64
	bool "Ngxxfus Fus one binary 64-bit build"
	help
	  Support for all armv8 based Ngxxfus Fus variants, such as
	  the NFus 4 model B, in AArch64 (64-bit) mode.
	select ARM64
	imply OF_HAS_PRIOR_STAGE

endchoice

config SYS_BOARD
	default "nfus"

config SYS_VENDOR
	default "ngxxfusfus"

config SYS_SOC
	default "nf283x"

config SYS_CONFIG_NAME
	default "nfus"

source "board/ngxxfusfus/nfus/Kconfig"

endmenu
```

## board/ngxxfus/myrpi4/Kconfig
```kconfig
# board/ngxxfus/myrpi4/Kconfig

# config TARGET_MYRPI4
#     bool "Support NGXXFUS MYRPI4 board"
#     depends on ARM
#     select ARCH_BCM283X
#     select MMC
#     select MMC_SDHCI
#     select MMC_SDHCI_BCM2835
#     select DM_SERIAL
#     select BCM2835_SERIAL
#     help
#       Support for NGXXFUS MYRPI4 custom board based on Raspberry Pi 4 (BCM2711).

if TARGET_MYRPI4
config SYS_BOARD
    string
    default "myrpi4"

config SYS_VENDOR
    string
    default "ngxxfus"

config SYS_CONFIG_NAME
    string
    default "myrpi4"
endif
```

## board/ngxxfus/myrpi4cp/Kconfig
```kconfig
if SYS_BOARD = "myrpi4cp"

	config RPI_EFI_NR_SPIN_PAGES
		int "[myrpi4cp/Kconfig] Spin table page count"
		default 1
		help
			Number of pages to reserve starting at page 0 for spin tables in the EFI
			memory map

endif
```

## board/ngxxfusfus/nfus/Kconfig
```kconfig
if SYS_BOARD = "nfus"

config NFUS_EFI_NR_SPIN_PAGES
	int "Spin table page count"
	default 1
	help
	  Number of pages to reserve starting at page 0 for spin tables in the EFI
	  memory map

endif
```

## drivers/pinctrl/fakebroadcom/Kconfig
```kconfig
config PINCTRL_NF283X
	depends on ARCH_NF283X && PINCTRL_FULL && OF_CONTROL
	default y
	bool "FakeBroadcom 283x family pin control driver"
	help
	   Support pin multiplexing and pin configuration control on
	   FakeBroadcom's 283x family of SoCs.

config PINCTRL_NF6838
	depends on ARCH_BMIPS && PINCTRL_FULL && OF_CONTROL
	default y
	bool "FakeBroadcom 6838 family pin control driver"
	help
	   Support pin multiplexing and pin configuration control on
	   FakeBroadcom's 6838 family of SoCs.
```

## drivers/pinctrl/ngxxfus/Kconfig
```kconfig
config PINCTRL_NF271X
	depends on ARCH_NF271X && PINCTRL_FULL && OF_CONTROL
	default y
	bool "NGXXFUS 271x family pin control driver"
	help
	   Support pin multiplexing and pin configuration control on
	   Broadcom's 283x family of SoCs.

# config PINCTRL_NF2718
# 	depends on ARCH_BMIPS && PINCTRL_FULL && OF_CONTROL
# 	default y
# 	bool "Broadcom 6838 family pin control driver"
# 	help
# 	   Support pin multiplexing and pin configuration control on
# 	   Broadcom's 6838 family of SoCs.
```

## drivers/tee/ngxxfus/Kconfig
```kconfig
config CHIMP_OPTEE
	bool "[NGXXFUS] Enable secure ChiMP firmware loading"
	depends on OPTEE
	default y
	help
	  This driver is used to load bnxt firmware binary using OpTEE.
	  bnxt is NGXXFUS NetXtreme controller Ethernet card.
```
